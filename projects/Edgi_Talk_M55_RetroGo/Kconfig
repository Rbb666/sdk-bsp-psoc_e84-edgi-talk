## projects/Edgi_Talk_M55_SDLPAL/Kconfig
```kconfig
mainmenu "RT-Thread Configuration"

config BSP_DIR
    string
    option env="BSP_ROOT"
    default "."

config RTT_DIR
    string
    option env="RTT_ROOT"
    default "rt-thread"

# you can change the RTT_ROOT default "rt-thread"
# example : default "F:/git_repositories/rt-thread"

config PKGS_DIR
    string
    option env="PKGS_ROOT"
    default "packages"

config ENV_DIR
    string
    option env="ENV_ROOT"
    default "/"

config PLATFORM_DIR
    string
    option env="PLATFORM_DIR"
    default "platform"

config BSP_USING_SDLPAL
    bool
    select BSP_USING_AUDIO
    select BSP_USING_AUDIO_PLAY
    default y

choice
    prompt "SDLPal input method"
    depends on BSP_USING_SDLPAL
    default BSP_SDLPAL_INPUT_USB_KEYBOARD

config BSP_SDLPAL_INPUT_TOUCH
    bool "Touch screen controls"

config BSP_SDLPAL_INPUT_USB_KEYBOARD
    bool "USB Host keyboard"
    select RT_USING_CHERRYUSB
    select RT_CHERRYUSB_HOST
    select RT_CHERRYUSB_HOST_DWC2_INFINEON
    select RT_CHERRYUSB_HOST_HID

endchoice

config BSP_LCD_VGLITE_INDEXED
    bool "Enable SDLPal VG-Lite indexed framebuffer blit"
    depends on BSP_USING_SDLPAL
    default y

source "$RTT_DIR/Kconfig"
source "$PKGS_DIR/Kconfig"
source "$RTT_DIR/../libraries/M55_Config/Kconfig"
source "$RTT_DIR/../libraries/components/CherryUSB-1.6.0/Kconfig.rtt"
```
